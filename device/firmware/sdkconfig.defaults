## device/firmware/sdkconfig.defaults
```kconfig
# PegaVox ESP32-S3 Default Configuration

# Enable ESP32-S3 target
CONFIG_IDF_TARGET="esp32s3"

# FreeRTOS configuration
CONFIG_FREERTOS_HZ=1000

# UART configuration
CONFIG_UART_ISR_IN_IRAM=y

# Logging
CONFIG_LOG_DEFAULT_LEVEL_INFO=y
CONFIG_LOG_MAXIMUM_LEVEL_VERBOSE=y

# Compiler optimizations
CONFIG_COMPILER_OPTIMIZATION_SIZE=y

# Partition table
CONFIG_PARTITION_TABLE_SINGLE_APP=y
```
